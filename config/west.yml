## config/west.yml
```yaml
manifest:
  #defaults:
  #  revision: v0.3
  remotes:
    - name: zmkfirmware
      url-base: https://github.com/zmkfirmwarenice_view
    - name: m165437
      url-base: https://github.com/M165437
  projects:
    - name: zmk
      remote: zmkfirmware
      revision: main
      import: app/west.yml
    - name: nice-view-gem
      remote: m165437
      revision: main
  self:
    path: config
```
